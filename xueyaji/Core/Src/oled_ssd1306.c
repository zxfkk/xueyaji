/**
  ******************************************************************************
  * @file    oled_ssd1306.c
  * @brief   0.96寸 OLED (SSD1306) 完整驱动实现 (内置全套 8x16 ASCII 字模与进度条渲染)
  *          支持自动识别接在 PB6/PB7 (与传感器共线) 或 PB10/PB11 (独立通道)
  ******************************************************************************
  */
#include "oled_ssd1306.h"
#include "xgzp6847d.h"
#include <stdio.h>
#include <string.h>

static I2C_Bus_t s_oled_bus = I2C_BUS_1;
static uint8_t   s_oled_gram[8][128];
static uint8_t s_tx_gram[8][128];
static uint16_t s_tx_offset=1024U;

/* 标准 8x16 ASCII 点阵字库 (覆盖 ASCII 0x20 ' ' ~ 0x7E '~' 共 95 个可打印字符) */
static const uint8_t F8X16[95][16] = {
    {0x00,0x00,0x00,0x00,0x00,0x00,0x00,0x00,0x00,0x00,0x00,0x00,0x00,0x00,0x00,0x00}, /* ' ' */
    {0x00,0x00,0x00,0xF8,0x00,0x00,0x00,0x00,0x00,0x00,0x00,0x33,0x30,0x00,0x00,0x00}, /* '!' */
    {0x00,0x10,0x0C,0x06,0x10,0x0C,0x06,0x00,0x00,0x00,0x00,0x00,0x00,0x00,0x00,0x00}, /* '"' */
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    {0x00,0x06,0x01,0x01,0x02,0x02,0x04,0x04,0x00,0x00,0x00,0x00,0x00,0x00,0x00,0x00}  /* '~' */
};

static void OLED_WriteCmd(uint8_t cmd) {
    BSP_I2C_WriteReg(s_oled_bus, OLED_I2C_ADDR, 0x00U, cmd);
}

void OLED_Init(void) {
    /* 上电等待 50ms 确保 SSD1306 内部复位电路稳压完成 */
    HAL_Delay(50);

    /* 自动探测 OLED 接在 PB6/PB7 (I2C_BUS_1) 还是 PB10/PB11 (I2C_BUS_2) */
    if (BSP_I2C_CheckDevice(I2C_BUS_1, OLED_I2C_ADDR)) {
        s_oled_bus = I2C_BUS_1;
    } else if (BSP_I2C_CheckDevice(I2C_BUS_2, OLED_I2C_ADDR)) {
        s_oled_bus = I2C_BUS_2;
    } else {
        s_oled_bus = I2C_BUS_1;
    }

    static const uint8_t init_cmds[] = {
        0xAE,       /* 关闭显示 */
        0xD5, 0x80, /* 设置时钟分频因子 */
        0xA8, 0x3F, /* 设置驱动路数 (1/64 duty) */
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        0xA6,       /* 正常显示 (非反相) */
        0xAF        /* 开启 OLED 面板显示 */
    };

    for (uint8_t i = 0; i < sizeof(init_cmds); i++) {
        OLED_WriteCmd(init_cmds[i]);
    }
    OLED_Clear();
    OLED_Refresh();
}

void OLED_Clear(void) {
    memset(s_oled_gram, 0, sizeof(s_oled_gram));
}

void OLED_Refresh(void) {
    if (s_tx_offset<1024U) return;
    memcpy(s_tx_gram,s_oled_gram,sizeof(s_tx_gram));
    s_tx_offset=0;
}
bool OLED_IsBusy(void) { return s_tx_offset<1024U; }
void OLED_Service(void) {
    uint8_t page,col;
    if (s_tx_offset>=1024U) return;
    page=(uint8_t)(s_tx_offset/128U); col=(uint8_t)(s_tx_offset%128U);
    OLED_WriteCmd(0xB0U+page);
    OLED_WriteCmd(col&15U); OLED_WriteCmd(0x10U|(col>>4));
    if (!BSP_I2C_WriteMulti(s_oled_bus,OLED_I2C_ADDR,0x40U,&s_tx_gram[page][col],8U)) {
        s_tx_offset=1024U; return;
    }
    s_tx_offset+=8U;
}

void OLED_ShowChar(uint8_t x, uint8_t y, char chr, uint8_t size) {
    (void)size;
    if (chr < ' ' || chr > '~') chr = ' ';
    uint8_t idx  = (uint8_t)(chr - ' ');
    uint8_t page = y / 8U;
    if (page >= 7U || x > 120U) return;

    for (uint8_t i = 0; i < 8U; i++) {
        s_oled_gram[page][x + i]     = F8X16[idx][i];
        s_oled_gram[page + 1U][x + i] = F8X16[idx][i + 8U];
    }
}

void OLED_ShowString(uint8_t x, uint8_t y, const char *str, uint8_t size) {
    while (str && *str) {
        if (x > 120U) break;
        OLED_ShowChar(x, y, *str++, size);
        x += 8U;
    }
}

void OLED_DrawPressureBar(float current_pressure, float target_pressure, uint16_t pulse_cnt) {
    char buf1[20], buf2[20];
    OLED_Clear();

    /* 第 0~1 页 (黄色标题区): 显示当前状态与已捕获脉搏数 */
    snprintf(buf1, sizeof(buf1), "BP Measuring P%02u", pulse_cnt);
    OLED_ShowString(0, 0, buf1, 16);

    /* 第 2~3 页: 显示实时袖带气压 mmHg (若传感器 I2C 未连接则直接提示 Sensor NoACK!) */
    if (!XGZP6847D_IsOnline()) {
        OLED_ShowString(0, 20, "Sensor NoACK!   ", 16);
    } else {
        snprintf(buf2, sizeof(buf2), "P: %3.0f/%3.0f mmHg", current_pressure, target_pressure);
        OLED_ShowString(0, 20, buf2, 16);
    }

    /* 第 6~7 页: 绘制图形化实时气压进度条 (宽度 0 ~ 120 像素) */
    int32_t bar_w = (int32_t)((current_pressure / 200.0f) * 120.0f);
    if (bar_w < 0)   bar_w = 0;
    if (bar_w > 120) bar_w = 120;

    for (uint8_t col = 4; col < 124; col++) {
        uint8_t fill = ((col - 4) < (uint8_t)bar_w) ? 0xFFU : 0x81U;
        s_oled_gram[6][col] = fill;
    }
    OLED_Refresh();
}

void OLED_ShowResult(float sbp, float dbp, uint16_t hr) {
    char buf1[20], buf2[20];
    OLED_Clear();
    OLED_ShowString(8, 0, "== BP RESULT ==", 16);
    snprintf(buf1, sizeof(buf1), "SYS/DIA:%3.0f/%2.0f", sbp, dbp);
    snprintf(buf2, sizeof(buf2), "PULSE:  %3u bpm", hr);
    OLED_ShowString(0, 22, buf1, 16);
    OLED_ShowString(0, 44, buf2, 16);
    OLED_Refresh();
}

void OLED_ShowError(uint8_t err_code) {
    char buf[20];
    OLED_Clear();
    OLED_ShowString(16, 0, "!! ERROR !!", 16);
    if (err_code == 1) {
        OLED_ShowString(4, 24, "E01:OverPress!", 16);
    } else if (err_code == 2) {
        OLED_ShowString(4, 24, "E02:Cuff Leak!", 16);
    } else {
        snprintf(buf, sizeof(buf), "E0%u:Weak Pulse", err_code);
        OLED_ShowString(4, 24, buf, 16);
    }
    OLED_ShowString(0, 46, "Press RESET/A0  ", 16);
    OLED_Refresh();
}
